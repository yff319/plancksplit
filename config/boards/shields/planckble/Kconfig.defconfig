## config/boards/shields/planckble/Kconfig.defconfig
```kconfig
# Copyright (c) 2021 The ZMK Contributors
# SPDX-License-Identifier: MIT
if SHIELD_PLANCKBLE_LEFT

config ZMK_KEYBOARD_NAME
    default "Planck Duos BLE"

config ZMK_SPLIT_ROLE_CENTRAL
    default y

endif

if SHIELD_PLANCKBLE_LEFT || SHIELD_PLANCKBLE_RIGHT

config ZMK_SPLIT
    default y

endif
```

## config/boards/shields/planckble/Kconfig.shield
```kconfig
# Copyright (c) 2021 The ZMK Contributors
# SPDX-License-Identifier: MIT
config SHIELD_PLANCKBLE_LEFT
    def_bool $(shields_list_contains,planckble_left)

config SHIELD_PLANCKBLE_RIGHT
    def_bool $(shields_list_contains,planckble_right)
```
